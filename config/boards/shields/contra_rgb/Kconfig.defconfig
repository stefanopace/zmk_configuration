## config/boards/shields/contra_rgb/Kconfig.defconfig
```kconfig
# Copyright (c) 2021 The ZMK Contributors
# SPDX-License-Identifier: MIT

if SHIELD_CONTRA_RGB

config ZMK_KEYBOARD_NAME
    default "Contra Keyboard"

endif
```

## config/boards/shields/contra_rgb/Kconfig.shield
```kconfig
# Copyright (c) 2021 The ZMK Contributors
# SPDX-License-Identifier: MIT

config SHIELD_CONTRA_RGB
	def_bool $(shields_list_contains,contra_rgb)
```
